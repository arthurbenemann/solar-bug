## Kconfig
```
source "Kconfig.zephyr"
rsource "../../prstlib/Kconfig"

config PRST_SLEEP_DURATION_SEC
	int "Sleep duration in seconds"
	default 60

config PRST_BLE_ADV_DURATION_SEC
	int "Advertising duration in seconds"
	default 500

choice PRST_BLE_ENCODING
	prompt "b-parasite BLE encoding"
	default PRST_BLE_ENCODING_BTHOME_V2

config PRST_BLE_ENCODING_BPARASITE_V2
	bool "Uses the custom b-parasite protocol v2 for encoding advertising packets"

config PRST_BLE_ENCODING_BTHOME_V1
	bool "Uses the BTHome (bthome.io) BLE encoding (v1)"

config PRST_BLE_ENCODING_BTHOME_V2
	bool "Uses the BTHome (bthome.io) BLE encoding (v2)"

endchoice  # PRST_BLE_ENCODING

config PRST_BLE_ENCODING_SERVICE_DATA_LEN
	int
	help
		Size of the service data buffer.
	default 20 if PRST_BLE_ENCODING_BPARASITE_V2
	default 18 if PRST_BLE_ENCODING_BTHOME_V1
	default 18 if PRST_BLE_ENCODING_BTHOME_V2


config PRST_BLE_HAS_USER_DEFINED_RANDOM_STATIC_ADDR
	bool "Whether to use a custom BLE address"

config PRST_BLE_USER_DEFINED_RANDOM_STATIC_ADDR
	string "Overrides the device's BT address"
	help
		This address has to be random static (e.g.: f0:ca:f0:ca:01:d5).
	depends on PRST_BLE_HAS_USER_DEFINED_RANDOM_STATIC_ADDR
```

## prj.conf
```kconfig
CONFIG_LOG=y
CONFIG_PWM=y
CONFIG_CBPRINTF_FP_SUPPORT=y
#CONFIG_I2C=y
CONFIG_ADC=y
CONFIG_GPIO=y
CONFIG_SENSOR=y
CONFIG_TEMP_NRF5=y

CONFIG_BT=y
CONFIG_BT_PERIPHERAL=y
CONFIG_BT_DEVICE_NAME="solarb"
CONFIG_BT_CTLR_TX_PWR_PLUS_8=y

CONFIG_SERIAL=n
CONFIG_PM=y
CONFIG_PM_DEVICE=y

CONFIG_USE_SEGGER_RTT=y

CONFIG_NEWLIB_LIBC=y
CONFIG_NEWLIB_LIBC_FLOAT_PRINTF=y

# Application config - see all options in Kconfig.
# CONFIG_PRST_BLE_ENCODING_BTHOME_V1=y
# CONFIG_PRST_SLEEP_DURATION_SEC=1
```

## src/main.c
```c
#include <prstlib/adc.h>
#include <prstlib/button.h>
#include <prstlib/led.h>
#include <prstlib/macros.h>
#include <prstlib/sensors.h>
#include <prstlib/shtc3.h>
#include <zephyr/kernel.h>
#include <zephyr/logging/log.h>
#include <zephyr/pm/device.h>
#include <zephyr/pm/pm.h>
#include <zephyr/pm/policy.h>

#include "ble.h"

LOG_MODULE_REGISTER(main, LOG_LEVEL_DBG);

int main(void) {
  RET_IF_ERR(prst_adc_init());
  RET_IF_ERR(prst_led_init());
  RET_IF_ERR(prst_ble_init());

  RET_IF_ERR(prst_led_flash(2));

  prst_sensors_t sensors;
  while (true) {
    prst_led_on(2);

    RET_IF_ERR(prst_sensors_read_all(&sensors));

    RET_IF_ERR(prst_ble_adv_set_data(&sensors));
    RET_IF_ERR(prst_ble_adv_start());

    k_sleep(K_MSEC(CONFIG_PRST_BLE_ADV_DURATION_SEC));

    RET_IF_ERR(prst_ble_adv_stop());

    prst_led_off(2);
    k_sleep(K_SECONDS(CONFIG_PRST_SLEEP_DURATION_SEC));
  }
}
```

## src/encoding.c
```c
#include "encoding.h"

#include <prstlib/macros.h>
#include <zephyr/logging/log.h>

LOG_MODULE_DECLARE(ble, LOG_LEVEL_INF);

int prst_ble_encode_service_data(const prst_sensors_t* sensors,
                                 const bt_addr_le_t* bt_addr, uint8_t* out,
                                 uint8_t out_len) {
  RET_CHECK(out_len >= CONFIG_PRST_BLE_ENCODING_SERVICE_DATA_LEN,
            "Buffer is not large enough");

#if CONFIG_PRST_BLE_ENCODING_BPARASITE_V2
  // 0x181a - Environmental sensing service UUID.
  out[0] = 0x1a;
  out[1] = 0x18;
  // Four bits for the protocol version.
  out[2] |= (2 << 4) & 0xf0;
  // Bit 0 of byte 0 specifies whether or not ambient light data exists in the
  // payload.
#if DT_NODE_EXISTS(DT_NODELABEL(photo_transistor)) || DT_NODE_EXISTS(DT_NODELABEL(ldr))
  out[2] |= 1;
#endif
  // 4 bits for a small wrap-around counter for deduplicating messages on the
  // receiver.
  // out[3] = sensors->run_counter & 0x0f;
  out[4] = sensors->batt.adc_read.millivolts >> 8;
  out[5] = sensors->batt.adc_read.millivolts & 0xff;
  int16_t temp_centicelsius = 100 * sensors->shtc3.temp_c;
  out[6] = temp_centicelsius >> 8;
  out[7] = temp_centicelsius & 0xff;
  uint16_t humi = sensors->shtc3.rel_humi * UINT16_MAX;
  out[8] = humi >> 8;
  out[9] = humi & 0xff;
  uint16_t soil_moisture = sensors->soil.percentage * UINT16_MAX;
  out[10] = soil_moisture >> 8;
  out[11] = soil_moisture & 0xff;
  // MAC address in big-endian.
  memcpy(out + 12, bt_addr->a.val, BT_ADDR_SIZE);
  out[18] = sensors->photo.brightness >> 8;
  out[19] = sensors->photo.brightness & 0xff;

// https://bthome.io/v1/
#elif CONFIG_PRST_BLE_ENCODING_BTHOME_V1

  // 0x181c - User data service UUID.
  out[0] = 0x1c;
  out[1] = 0x18;

  // 1. Soil moisture.
  // uint16_t.
  out[2] = (0b000 << 5) | 3;
  // Type of measurement - Moisture.
  out[3] = 0x14;
  // Value. Factor of 0.01, so we need to multiply our the value in 100% by
  // 1/0.01 = 100.
  uint16_t soil_val = 10000 * sensors->soil.percentage;
  out[4] = soil_val & 0xff;
  out[5] = soil_val >> 8;
  // 2. Temp.
  // int16_t.
  out[6] = (0b001 << 5) | 3;
  // Type of measurement - temperature.
  out[7] = 0x02;
  // Value. Factor 0.01.
  int16_t temp_val = 100 * sensors->shtc3.temp_c;
  out[8] = temp_val & 0xff;
  out[9] = temp_val >> 8;
  // 3. Humidity
  // uint16_t.
  out[10] = (0b000 << 5) | 3;
  // Type - humidity.
  out[11] = 0x03;
  // Value. Factor 0.01, over 100%.
  uint16_t humi_val = 10000 * sensors->shtc3.rel_humi;
  out[12] = humi_val & 0xff;
  out[13] = humi_val >> 8;
  // 4. Battery voltage.
  // uint16_t.
  out[14] = (0b000 << 5) | 3;
  // Type - voltage.
  out[15] = 0x0c;
  // Value. Factor of 0.001.
  uint16_t batt_val = sensors->batt.adc_read.millivolts;
  out[16] = batt_val & 0xff;
  out[17] = batt_val >> 8;

// https://bthome.io/format/
#elif CONFIG_PRST_BLE_ENCODING_BTHOME_V2
  // 0xfcd2 - bthome.io service UUID.
  out[0] = 0xd2;
  out[1] = 0xfc;

  // Service header - no encryption, bt home v2.
  out[2] = 0x40;

  // Temperature.
  out[3] = 0x02;
  int16_t temp_val = 100 * sensor_value_to_double(&sensors->temp.temp);
  out[4] = temp_val & 0xff;
  out[5] = temp_val >> 8;

  // Battery voltage.
  out[6] = 0x0c;
  // Value. Factor of 0.001.
  uint16_t batt_val = sensors->batt.adc_read.millivolts;
  out[7] = batt_val & 0xff;
  out[8] = batt_val >> 8;
  
  // Soil moisture top.
  out[9] = 0x14;
  // Factor of 0.01, so we need to multiply our the value in 100% by 1/0.01 = 100.
  int16_t soil_val = sensors->soil1.adc_read.raw;
  out[10] = soil_val & 0xff;
  out[11] = soil_val >> 8;

    // Soil moisture mid.
  out[12] = 0x14;
  // Factor of 0.01, so we need to multiply our the value in 100% by 1/0.01 = 100.
  uint16_t soil_val2 = 0;
  out[13] = soil_val2 & 0xff;
  out[14] = soil_val2 >> 8;

  // Soil moisture bot.
  out[15] = 0x14;
  // Factor of 0.01, so we need to multiply our the value in 100% by 1/0.01 = 100.
  uint16_t soil_val3 = 0;
  out[16] = soil_val3 & 0xff;
  out[17] = soil_val3 >> 8;


#endif  // Encoding protocols

  LOG_HEXDUMP_DBG(out, out_len, "Encoded BLE adv: ");
  return 0;
}
```
